## arch/arm/hotplug/Kconfig
```kconfig
config INTELLI_PLUG
	bool "Intelli hotplug driver"
	depends on HOTPLUG_CPU
	default y
	help
	  An intelligent cpu hotplug driver for
	  Low Latency Frequency Transition capable processors.
```
